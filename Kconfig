## Kconfig
```kconfig
menu "RT-Thread custom online packages"

source "$PKGS_DIR/custom_packages/iot/Kconfig"
source "$PKGS_DIR/custom_packages/security/Kconfig"
source "$PKGS_DIR/custom_packages/language/Kconfig"
source "$PKGS_DIR/custom_packages/multimedia/Kconfig"
source "$PKGS_DIR/custom_packages/tools/Kconfig"
source "$PKGS_DIR/custom_packages/system/Kconfig"
source "$PKGS_DIR/custom_packages/peripherals/Kconfig"
source "$PKGS_DIR/custom_packages/misc/Kconfig"

endmenu
```

## peripherals/Kconfig
```kconfig
menu "peripheral libraries and drivers"

source "$PKGS_DIR/custom_packages/peripherals/st7735r_tft/Kconfig"
source "$PKGS_DIR/custom_packages/peripherals/sensors/mt9v034_camera/Kconfig"
source "$PKGS_DIR/custom_packages/peripherals/soft_i2c/Kconfig"
source "$PKGS_DIR/custom_packages/peripherals/xpt2046_touch/Kconfig"

endmenu
```
